## device/esp32/main/Kconfig.projbuild
```kconfig
menu "Anka Handpad"
    config ANKA_ALLOW_INSECURE_LOCAL
        bool "Allow HTTP/WS for trusted local development only"
        default n
    config ANKA_GYRO_YAW_SIGN
        int "Gyro yaw axis sign: 1 or -1, verify on hardware"
        range -1 1
        default -1
    config ANKA_GYRO_PITCH_SIGN
        int "Gyro pitch axis sign: 1 or -1, verify on hardware"
        range -1 1
        default 1
endmenu
```

## device/esp32/sdkconfig.defaults
```kconfig
CONFIG_IDF_TARGET="esp32s31"
CONFIG_IDF_EXPERIMENTAL_FEATURES=y
CONFIG_COMPILER_OPTIMIZATION_PERF=y
CONFIG_ESPTOOLPY_FLASHSIZE_16MB=y
CONFIG_PARTITION_TABLE_CUSTOM=y
CONFIG_PARTITION_TABLE_CUSTOM_FILENAME="partitions.csv"
CONFIG_FREERTOS_HZ=1000
CONFIG_SPIRAM=y
CONFIG_SPIRAM_MODE_OCT=y
CONFIG_SPIRAM_XIP_FROM_PSRAM=y
CONFIG_SPIRAM_SPEED_250M=y
CONFIG_SPIRAM_MEMTEST=n
CONFIG_SPIRAM_MALLOC_ALWAYSINTERNAL=4096
CONFIG_SPIRAM_ALLOW_BSS_SEG_EXTERNAL_MEMORY=y
CONFIG_ESP_CONSOLE_UART_DEFAULT=y
# Camera uses GPIO33: do not enable USB Serial/JTAG on that pad.
# CONFIG_ESP_CONSOLE_USB_SERIAL_JTAG is not set
# CONFIG_ESP_CONSOLE_SECONDARY_USB_SERIAL_JTAG is not set
# CONFIG_USJ_ENABLE_USB_SERIAL_JTAG is not set
CONFIG_BSP_CO5300_ENABLE_TE=y
CONFIG_BSP_DISPLAY_ENABLE=y
CONFIG_BSP_DISPLAY_LVGL_ENABLE=y
CONFIG_LV_CONF_SKIP=y
CONFIG_LV_COLOR_DEPTH_16=y
CONFIG_LV_OS_FREERTOS=y
CONFIG_LV_DEF_REFR_PERIOD=20
CONFIG_LV_DPI_DEF=130
CONFIG_LV_USE_CLIB_MALLOC=y
CONFIG_LV_USE_CLIB_STRING=y
CONFIG_LV_USE_CLIB_SPRINTF=y
CONFIG_LV_FONT_MONTSERRAT_20=y
CONFIG_LV_FONT_MONTSERRAT_28=y
CONFIG_MOSAICO_MODULE_CAMERA=y
CONFIG_CAMERA_OV3640=y
CONFIG_CAMERA_OV3640_AUTO_DETECT_DVP_INTERFACE_SENSOR=y
CONFIG_CAMERA_OV3640_DVP_YUV422_UYVY_1024X768_25FPS=y
CONFIG_CAMERA_OV3640_DVP_DEFAULT_FMT_YUV422_UYVY_1024X768_25FPS=y
CONFIG_ESP_VIDEO_ENABLE_DVP_VIDEO_DEVICE=y
CONFIG_MBEDTLS_CERTIFICATE_BUNDLE=y
CONFIG_MBEDTLS_CERTIFICATE_BUNDLE_DEFAULT_FULL=y

CONFIG_ESPTOOLPY_FLASHMODE_QIO=y
CONFIG_ESP_COREDUMP_ENABLE_TO_FLASH=y
CONFIG_APP_RETRIEVE_LEN_ELF_SHA=64
CONFIG_BOOTLOADER_APP_ROLLBACK_ENABLE=y
CONFIG_FACTORY_RECOVERY_BOOT_GPIO=7
CONFIG_FACTORY_RECOVERY_BOOT_DEBOUNCE_MS=50
CONFIG_ESP_CONSOLE_SECONDARY_NONE=y
CONFIG_ESP_IRIS_TRANSPORT_USB=y
CONFIG_ESP_IRIS_TRANSPORT_TCP=y
CONFIG_ESP_IRIS_NVS_PARTITION_NAME="sysmeta"
CONFIG_ESP_IRIS_TCP_PORT=19772
CONFIG_ESP_IRIS_TCP_PAIRING=y
CONFIG_ESP_IRIS_TCP_DEFER_UNTIL_NETIF=y
CONFIG_ESP_IRIS_SERVICE_PERSISTENT=y
CONFIG_ESP_IRIS_TASK_STACK_SIZE=3328
CONFIG_ESP_IRIS_USB_TASK_STACK_SIZE=2048
CONFIG_ESP_IRIS_SERVICE_STACK_SIZE=8192
CONFIG_ESP_IRIS_SERVICE_CONTEXT_PSRAM=y
CONFIG_ESP_IRIS_SERVICE_STATE_PSRAM=y
CONFIG_ESP_IRIS_RPC_RESPONSE_PSRAM=y
CONFIG_ESP_IRIS_MAX_RPC_HANDLERS=12
CONFIG_ESP_IRIS_WIRE_BUFFERS_PSRAM=y
CONFIG_ESP_IRIS_LOG_RING_BYTES=4096
CONFIG_ESP_IRIS_LOG_RING_STORAGE_PSRAM=y
CONFIG_TINYUSB_CDC_COUNT=2
CONFIG_ESP_MAIN_TASK_STACK_SIZE=12288

CONFIG_LV_USE_SNAPSHOT=y
CONFIG_ANKA_ALLOW_INSECURE_LOCAL=y
```
